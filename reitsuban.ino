#include <Wire.h>
#include <Adafruit_GFX.h>
#include <Adafruit_SSD1306.h>
#include <Adafruit_Sensor.h>
#include <Adafruit_HMC5883_U.h>

#define SCREEN_WIDTH 128
#define SCREEN_HEIGHT 64
#define OLED_RESET -1

Adafruit_SSD1306 display(SCREEN_WIDTH, SCREEN_HEIGHT, &Wire);		// create new 128x64 display object
Adafruit_HMC5883_Unified mag = Adafruit_HMC5883_Unified(12345);		// create new HMC5883 object

const int bufferSize = 20;          // we want the last 20 ghost letters
char buffer[bufferSize + 1] = {0};  // +1 for null terminator; 
unsigned long start_time, current_time;           // for timing
int delta_time;
int delay_time = 100;

const char alphabet[] = "abcdefghijklmnopqrstuvwxyz ";

// Define the splash screen bitmap here
const unsigned char splashScreen[] PROGMEM = {
	0xff, 0xff, 0xff, 0xff, 0xff, 0xff, 0xff, 0xff, 0xff, 0xff, 0xff, 0xff, 0xff, 0xff, 0xff, 0xff,
	0xff, 0xff, 0xff, 0xff, 0xff, 0xff, 0xff, 0xff, 0xff, 0xff, 0xff, 0xff, 0xff, 0xff, 0xff, 0xff,
	0xff, 0xff, 0xff, 0xff, 0xff, 0xff, 0xff, 0xff, 0xff, 0xff, 0xff, 0xff, 0xff, 0xff, 0xff, 0xff,
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	0xff, 0xff, 0xff, 0xff, 0xff, 0xff, 0xff, 0xff, 0xff, 0xff, 0xff, 0xff, 0xff, 0xff, 0xff, 0xff};

// Define the letters bitmap here
const unsigned char letters[] PROGMEM = {
	0x00, 0x00, 0x00, 0x00, 0x00, 0x00, 0x00, 0x00, 0x00, 0x00, 0x00, 0x00, 0x00, 0x00, 0x00, 0x00,
	0x00, 0x00, 0x00, 0x00, 0x00, 0x00, 0x00, 0x00, 0x00, 0x00, 0x00, 0x00, 0x00, 0x00, 0x00, 0x00,
	0x00, 0x00, 0x00, 0x00, 0x00, 0x00, 0x00, 0x00, 0x00, 0x00, 0x00, 0x00, 0x00, 0x00, 0x00, 0x00,
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	0x00, 0x00, 0x00, 0x00, 0x00, 0x00, 0x00, 0x00, 0x00, 0x00, 0x00, 0x00, 0x00, 0x00, 0x00, 0x00};

struct MagneticReading
{
	float x, y, z;
};

MagneticReading prevReading = {0, 0, 0};

// ---------------------------------------------------------------------------------

void setup()
{

	// Initialize the buffer with spaces cause
	for (int i = 0; i < bufferSize; i++)
	{
		buffer[i] = ' ';
	}
	buffer[bufferSize + 1] = '\0'; // Null-terminate the buffer


	// wait for display to initialize
	if (!display.begin(SSD1306_SWITCHCAPVCC, 0x3C))
	{
		for (;;)
			;
	}

	// wait for magnetometer to initialize
	if (!mag.begin())
	{
		for (;;)
			;
	}

	drawSplashScreen();	// this is the only time we draw the splash screen
	drawLetters();		// this is the only time we draw the letters bitmap

	sensors_event_t event;
	mag.getEvent(&event);
	prevReading = {event.magnetic.x, event.magnetic.y, event.magnetic.z}; // initialize prevReading
}

void drawSplashScreen() // this outputs the splashscreen one time
{
	display.clearDisplay();
	display.drawBitmap(0, 0, splashScreen, 128, 64, 1);
	display.display();
	delay(2000);
}

void drawLetters() // this outputs the letters bitmap one time
{
	display.clearDisplay();
	display.drawBitmap(0, 0, letters, 128, 64, 1);
	display.display();
}

void drawBox(int rowIndex, int columnIndex, bool invertToggle) // this draws the box around letters
{
	int x = columnIndex * 14 + 4; // box is 14 pixels wide * letter we are on + 4 pixel margin from top
	int y = rowIndex * 16 + 4;    // box is 16 pixels tall * row we are on + 4 pixel margin from left
	display.drawRect(x - 3, y - 3, 14, 16, invertToggle ? SSD1306_WHITE : SSD1306_BLACK); // draw box with 1 pixel padding around letter
	display.display();                                                                    // update the display each time we draw a box (?)
}

// yah its kinda dumb i gotta call with rowIndex and columnIndex but I wanted to flash the box
// probably a delay would work just as well. pause on that letter for effect
void querySpirit(char currentLetter, int letterIndex, int threshold = 13, int rowIndex = 0, int columnIndex = 0)
{
	// get new reading
	sensors_event_t event;
	mag.getEvent(&event);

	// calculate differnce between current and previous reading
	float delta = abs(event.magnetic.x - prevReading.x) + abs(event.magnetic.y - prevReading.y) + abs(event.magnetic.z - prevReading.z);

	if (delta > threshold)	// if current reading is more than threshold away from previous reading
	{
		memmove(buffer, buffer + 1, bufferSize - 1);      // Shift the buffer left
		buffer[bufferSize - 1] = currentLetter;           // Add the current letter at the end
		buffer[bufferSize] = '\0';                        // Null-terminate the buffer
		display.fillRect(0, 50, 128, 14, SSD1306_BLACK);  // Clear the display area for the buffer
		display.setTextSize(1);                           // Normal 1:1 pixel scale
		display.setTextColor(SSD1306_WHITE);              // Draw white text
		display.setCursor(4, 52);                         // set at bottom left of screen
		display.print(buffer);                            // print the buffer
		display.display();                                // update the display

		for (int i = 0; i < 13; i++) 					            // flash the box and be annoying
		{
			drawBox(rowIndex, columnIndex, false);
			drawBox(rowIndex, columnIndex, true);
		}
	}

	// Update previous reading
	prevReading = {event.magnetic.x, event.magnetic.y, event.magnetic.z};
}


void loop()
{
  start_time = millis();					        
	int letterIndex = 0;																                            // reset letterIndex
	for (int rowIndex = 0; rowIndex < 3; rowIndex++) { 									            // 3 rows
		for (int columnIndex = 0; columnIndex < 9; columnIndex++) {                   // 9 columns
			drawBox(rowIndex, columnIndex, true); 										                  // draw the box around the letter
			querySpirit(alphabet[letterIndex], letterIndex, 13, rowIndex, columnIndex); // 13 is the threshold for a new reading
      current_time = millis();                                                    // gets current time
      delta_time = current_time - start_time;                                     // subtracts start_time to get delta
      delay(delay_time - delta_time);                                             // subtract delta_time from delay_time to get actual delay and do it
      start_time = millis();                                                      // looks odd spot to start our time, but this is 1 loop, and it lets us pause erasing the box
			drawBox(rowIndex, columnIndex, false);										                  // erase the box around the letter
			letterIndex++;                                                              // increment letterIndex
 												                              
		}
	}
}
